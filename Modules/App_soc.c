/*
 * @Descripttion: 
 * @version: V2.0
 * @Author: czh
 * @Date: 2022-02-21 17:07:55
 * @LastEditors: czh
 * @LastEditTime: 2022-05-05 16:46:52
 */

#include <stdio.h>
#include <stdlib.h>
#include <math.h>
#include "App_soc.h"

/******************************************通用参数START******************************************/
#define BAT_PACK_NUM     6  //电池组数
#define SAMPLE_INTERVAL  1.0f  //采样基准时间
#define NOISE_VARIANCE  (25e-6)  //噪声方差
#define BAT_BY_SOH 50.0f  //电池截至SOH
#define DISCHARG_COEF  0.9f//充电转放电系数
#define FLOAT_VOLT_OFFSET  0.1f//浮充电压偏差
#define AMP_MUL 1000    //放大倍数
#define COUNT_ADD  3600 //累计计数3600s
static double OCV_tableDate[BAT_PACK_NUM][10]={0};
static double _nominal_cap[BAT_PACK_NUM]={1200,1200,1200,1200,1200,1200};//标称容量
static double _initial_cap[BAT_PACK_NUM]={1200,1200,1200,1200,1200,1200};//根据电流温度初始容量
static float _bat_life[BAT_PACK_NUM]={10,10,10,10,10,10};//实参传入电池寿命
const float rp_coef=1.0E-5;//等效电路极化内阻系数
static float rint_coef[BAT_PACK_NUM]={0};//等效电路内阻系数
static float _max_vol[BAT_PACK_NUM]={0};//最大电压
static float _min_vol[BAT_PACK_NUM]={0};//最小电压
static float _float_vol[BAT_PACK_NUM]={0};//浮充电压
static unsigned int _initial_soh[BAT_PACK_NUM]={0};//初始SOH
static int  return_soc[BAT_PACK_NUM] = {100,100,100,100,100};//计算返回SOC
static float _discharge_add_cap[BAT_PACK_NUM]={0,0,0,0,0,0};
static float _charge_add_cap[BAT_PACK_NUM]={0,0,0,0,0,0};
static unsigned int _deep_cycle_time[BAT_PACK_NUM]={1500,1500,1500,1500,1500,1500};
static float _diff_deep_cycle[BAT_PACK_NUM]={0,0,0,0,0,0};
/*******************************************通用参数END******************************************/

/******************************************模型仿真模块参数START******************************************/

/* Block states (default storage) */
DW_Model_simulation_T Model_simulation_DW;

/* External inputs (root inport signals with default storage) */
ExtU_Model_simulation_T Model_simulation_U[BAT_PACK_NUM];

/* External outputs (root outports fed by signals with default storage) */
ExtY_Model_simulation_T Model_simulation_Y[BAT_PACK_NUM];
/* Constant parameters (default storage) */
const ConstP_Model_simulation_T Model_simulation_ConstP = {
  /* Pooled Parameter (Mixed Expressions)
   * Referenced by:
   *   'Delay' (':184')
   *   'Random Source' (':259:3')
   */
  0.0, 

  /* Pooled Parameter (Mixed Expressions)
   * Referenced by:
   *   'tr' (':143')
   *   'Memory1' (':172')
   *   'Random Source' (':259:3')
   */
  1.0,

  /* Expression: [0.6, 0.6, 0.6, 0.6, 0.6, 0.6, 0.6]
   * Referenced by: '1-D Lookup Table' (':341')
   */
  { 0.6, 0.6, 0.6, 0.6, 0.6, 0.6, 0.6 },

  /* Pooled Parameter (Expression: [0.2:0.1:0.8])
   * Referenced by:
   *   '1-D Lookup Table' (':341')
   *   '1-D Lookup Table1' (':342')
   *   '1-D Lookup Table3' (':344')
   */
  { 0.2, 0.30000000000000004, 0.4, 0.5, 0.60000000000000009, 0.70000000000000007,
    0.8 },

  /* Expression: [3.623,4.678,4.566,4.180,3.804,5.026,4.181]
   * Referenced by: '1-D Lookup Table1' (':342')
   */
  { 3.623, 4.678, 4.566, 4.18, 3.804, 5.026, 4.181 },

  /* Expression: [1.927,	1.954,	1.981,	2.008,	2.035,	2.062,	2.089,	2.116,	2.143,	2.17
     ]
   * Referenced by: '1-D Lookup Table2' (':343')
   */
  { 1.94,	1.98,	2.02,	2.06,	2.1,	2.14,	2.18,	2.22,	2.26,	2.3 },

  /* Expression: [0.1:0.1:1]
   * Referenced by: '1-D Lookup Table2' (':343')
   */
  { 0.1, 0.2, 0.30000000000000004, 0.4, 0.5, 0.6, 0.7, 0.8, 0.9, 1.0 },

  /* Expression: [0.6, 0.6, 0.6, 0.6, 0.6, 0.6, 0.6]
   * Referenced by: '1-D Lookup Table3' (':344')
   */
  { 0.6, 0.6, 0.6, 0.6, 0.6, 0.6, 0.6 }
};
/******************************************模型仿真模块参数END******************************************/

/********************************************EKF算法参数START******************************************/
#define NumBitsPerChar                 8U

/* Invariant block signals (default storage) */
const ConstB_SOC_EKF_T SOC_EKF_ConstB = {
  -2.7777777777777779E-4               /* '<S3>/Fcn1' */
};

/* Constant parameters (default storage) */
const ConstP_SOC_EKF_T SOC_EKF_ConstP = {
  /* Expression: [0.6, 0.6, 0.6, 0.6, 0.6, 0.6, 0.6]
   * Referenced by: '<S1>/1-D Lookup Table'
   */
  { 0.6, 0.6, 0.6, 0.6, 0.6, 0.6, 0.6 },

  /* Pooled Parameter (Expression: [0.2:0.1:0.8])
   * Referenced by:
   *   '<S1>/1-D Lookup Table'
   *   '<S1>/1-D Lookup Table1'
   *   '<S1>/1-D Lookup Table3'
   */
  { 0.2, 0.30000000000000004, 0.4, 0.5, 0.60000000000000009, 0.70000000000000007,
    0.8 },

  /* Expression: [3.623,4.678,4.566,4.180,3.804,5.026,4.181]
   * Referenced by: '<S1>/1-D Lookup Table1'
   */
  { 3.623, 4.678, 4.566, 4.18, 3.804, 5.026, 4.181 },

  /* Expression: [1.927,	1.954,	1.981,	2.008,	2.035,	2.062,	2.089,	2.116,	2.143,	2.17
     ]
   * Referenced by: '<S1>/1-D Lookup Table4'
   */
  { 1.927, 1.954, 1.981, 2.008, 2.035, 2.062, 2.089, 2.116, 2.143, 2.17 },

  /* Expression: [0.1:0.1:1]
   * Referenced by: '<S1>/1-D Lookup Table4'
   */
  { 0.1, 0.2, 0.30000000000000004, 0.4, 0.5, 0.6, 0.7, 0.8, 0.9, 1.0 },

  /* Expression: [0.6, 0.6, 0.6, 0.6, 0.6, 0.6, 0.6]
   * Referenced by: '<S1>/1-D Lookup Table3'
   */
  { 0.6, 0.6, 0.6, 0.6, 0.6, 0.6, 0.6 }
};

/* Block states (default storage) */
DW_SOC_EKF_T SOC_EKF_DW[BAT_PACK_NUM];

/* External inputs (root inport signals with default storage) */
ExtU_SOC_EKF_T SOC_EKF_U;

/* External outputs (root outports fed by signals with default storage) */
ExtY_SOC_EKF_T SOC_EKF_Y[BAT_PACK_NUM]={0.99,0.99,0.99,0.99,0.99,0.99};

static real_T rtGetInf(void);
static real32_T rtGetInfF(void);
static real_T rtGetMinusInf(void);
static real32_T rtGetMinusInfF(void);
static real_T rtGetNaN(void);
static real32_T rtGetNaNF(void);
extern real_T rtInf;
extern real_T rtMinusInf;
extern real_T rtNaN;
extern real32_T rtInfF;
extern real32_T rtMinusInfF;
extern real32_T rtNaNF;
static void rt_InitInfAndNaN(size_t realSize);
static boolean_T rtIsInf(real_T value);
static boolean_T rtIsInfF(real32_T value);
static boolean_T rtIsNaN(real_T value);
static boolean_T rtIsNaNF(real32_T value);
typedef struct {
  struct {
    uint32_T wordH;
    uint32_T wordL;
  } words;
} BigEndianIEEEDouble;

typedef struct {
  struct {
    uint32_T wordL;
    uint32_T wordH;
  } words;
} LittleEndianIEEEDouble;

typedef struct {
  union {
    real32_T wordLreal;
    uint32_T wordLuint;
  } wordL;
} IEEESingle;

real_T rtInf;
real_T rtMinusInf;
real_T rtNaN;
real32_T rtInfF;
real32_T rtMinusInfF;
real32_T rtNaNF;
/********************************************EKF算法参数END******************************************/

/******************************************信号添加噪声参数START****************************************/

/* Constant parameters (default storage) */
const ConstP_Noise_T Noise_ConstP = {
  /* Expression: MeanVal
   * Referenced by: '<S1>/Random Source'
   */
  0.0,

  /* Computed Parameter: RandomSource_VarianceRTP
   * Referenced by: '<S1>/Random Source'
   */
  1.0
};

/* Block states (default storage) */
DW_Noise_T Noise_DW;

/* External inputs (root inport signals with default storage) */
ExtU_Noise_T Noise_U;

/* External outputs (root outports fed by signals with default storage) */
ExtY_Noise_T Noise_Y;
/******************************************信号添加噪声参数END****************************************/

/******************************************初始容量参数START**************************************/
/* Constant parameters (default storage) */
const ConstP_Cap_init_T Cap_init_ConstP = {
  /* Referenced by: real_T cap_tableData[24]
   */
  { 0.65, 0.74, 0.82, 0.9, 0.98, 1.04, 1.1, 1.14,
    0.5, 0.59, 0.67, 0.74, 0.8,0.86, 0.92, 0.98, 
    0.18, 0.25, 0.34, 0.4, 0.46, 0.52, 0.58, 0.62 },

  /* Referenced by:  real_T temp_Data[8]
   */
  { -20.0, -10.0, 0.0, 10.0, 20.0, 30.0, 40.0, 50.0 },

  /* Referenced by: real_T curcoeff_Data[3]
   */
  { 0.1, 0.2, 1.0 },

  /* Referenced by: uint32_T maxIndex[2]
   */
  { 7U, 2U }
};
/******************************************初始容量参数END****************************************/

/******************************************模型仿真模块START******************************************/
/**
 * @name: 
 * @msg: 
 * @param {uint32_T} seed
 * @param {uint32_T} state
 * @param {int32_T} nChans
 * @return {*}
 */
void RandSrcInitState_GZ(const uint32_T seed[], uint32_T state[], int32_T nChans)
{
  int32_T i;

  /* InitializeConditions for S-Function (sdsprandsrc2): 'Random Source' (':259:3') */
  /* RandSrcInitState_GZ */
  for (i = 0; i < nChans; i++) {
    int32_T tmp;
    tmp = i << 1;
    state[tmp] = 362436069U;
    state[tmp + 1] = seed[i] == 0U ? 521288629U : seed[i];
  }

  /* End of InitializeConditions for S-Function (sdsprandsrc2): 'Random Source' (':259:3') */
}

/**
 * @name: 
 * @msg: 
 * @param {*}
 * @return {*}
 */
real_T look1_binlxpw(real_T u0, const real_T bp0[], const real_T table[],
                     uint32_T maxIndex)
{
  real_T frac;
  real_T yL_0d0;
  uint32_T iLeft;

  /* Column-major Lookup 1-D
     Search method: 'binary'
     Use previous index: 'off'
     Interpolation method: 'Linear point-slope'
     Extrapolation method: 'Linear'
     Use last breakpoint for index at or above upper limit: 'off'
     Remove protection against out-of-range input in generated code: 'off'
   */
  /* Prelookup - Index and Fraction
     Index Search method: 'binary'
     Extrapolation method: 'Linear'
     Use previous index: 'off'
     Use last breakpoint for index at or above upper limit: 'off'
     Remove protection against out-of-range input in generated code: 'off'
   */
  if (u0 <= bp0[0U]) {
    iLeft = 0U;
    frac = (u0 - bp0[0U]) / (bp0[1U] - bp0[0U]);
  } else if (u0 < bp0[maxIndex]) {
    uint32_T bpIdx;
    uint32_T iRght;

    /* Binary Search */
    bpIdx = maxIndex >> 1U;
    iLeft = 0U;
    iRght = maxIndex;
    while (iRght - iLeft > 1U) {
      if (u0 < bp0[bpIdx]) {
        iRght = bpIdx;
      } else {
        iLeft = bpIdx;
      }

      bpIdx = (iRght + iLeft) >> 1U;
    }

    frac = (u0 - bp0[iLeft]) / (bp0[iLeft + 1U] - bp0[iLeft]);
  } else {
    iLeft = maxIndex - 1U;
    frac = (u0 - bp0[maxIndex - 1U]) / (bp0[maxIndex] - bp0[maxIndex - 1U]);
  }

  /* Column-major Interpolation 1-D
     Interpolation method: 'Linear point-slope'
     Use last breakpoint for index at or above upper limit: 'off'
     Overflow mode: 'portable wrapping'
   */
  yL_0d0 = table[iLeft];
  return (table[iLeft + 1U] - yL_0d0) * frac + yL_0d0;
}

/**
 * @name: 
 * @msg:  Function for MATLAB Function: ''真实状态' (':152')' 
 * @param {uint32_T} s
 * @param {uint32_T} *state
 * @param {real_T} *r
 * @return {*}
 */
static void Model_simulation_genrandu(uint32_T s, uint32_T *state, real_T *r)
{
  int32_T hi;
  uint32_T a;
  uint32_T b;
  hi = (int32_T)(s / 127773U);
  a = 16807U * (s - hi * 127773U);
  b = 2836U * hi;
  if (a < b) {
    *state = ~(b - a) & 2147483647U;
  } else {
    *state = a - b;
  }

  *r = (real_T)*state * 4.6566128752457969E-10;
}

/**
 * @name: 
 * @msg:  Function for MATLAB Function: ''真实状态' (':152')' 
 * @param {uint32_T} state
 * @return {*}
 */
static real_T Model_simulation_eml_rand_shr3cong(uint32_T state[2])
{
  real_T r;
  real_T x;
  real_T y;
  int32_T j;
  uint32_T icng;
  uint32_T jsr;
  uint32_T ui;
  static const real_T b[65] = { 0.340945, 0.4573146, 0.5397793, 0.6062427,
    0.6631691, 0.7136975, 0.7596125, 0.8020356, 0.8417227, 0.8792102, 0.9148948,
    0.9490791, 0.9820005, 1.0138492, 1.044781, 1.0749254, 1.1043917, 1.1332738,
    1.161653, 1.189601, 1.2171815, 1.2444516, 1.2714635, 1.298265, 1.3249008,
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    2.6713916, 2.7769942, 2.7769942, 2.7769942, 2.7769942 };

  icng = 69069U * state[0] + 1234567U;
  jsr = state[1] ^ state[1] << 13;
  jsr ^= jsr >> 17;
  jsr ^= jsr << 5;
  ui = icng + jsr;
  j = (int32_T)((ui & 63U) + 1U);
  r = (real_T)(int32_T)ui * 4.6566128730773926E-10 * b[j];
  x = fabs(r);
  y = b[j - 1];
  if (x <= y) {
  } else {
    real_T s;
    x = (x - y) / (b[j] - y);
    icng = 69069U * icng + 1234567U;
    jsr ^= jsr << 13;
    jsr ^= jsr >> 17;
    jsr ^= jsr << 5;
    y = (real_T)(int32_T)(icng + jsr) * 2.328306436538696E-10 + 0.5;
    s = x + y;
    if (s > 1.301198) {
      if (r < 0.0) {
        r = 0.4878992 * x - 0.4878992;
      } else {
        r = 0.4878992 - 0.4878992 * x;
      }
    } else if (s <= 0.9689279) {
    } else {
      x = 0.4878992 - 0.4878992 * x;
      if (y > 12.67706 - 12.37586 * exp(-0.5 * x * x)) {
        if (r < 0.0) {
          r = -x;
        } else {
          r = x;
        }
      } else if (exp(-0.5 * b[j] * b[j]) + y * 0.01958303 / b[j] <= exp(-0.5 * r
                  * r)) {
      } else {
        do {
          icng = 69069U * icng + 1234567U;
          jsr ^= jsr << 13;
          jsr ^= jsr >> 17;
          jsr ^= jsr << 5;
          x = log((real_T)(int32_T)(icng + jsr) * 2.328306436538696E-10 + 0.5) /
            2.776994;
          icng = 69069U * icng + 1234567U;
          jsr ^= jsr << 13;
          jsr ^= jsr >> 17;
          jsr ^= jsr << 5;
        } while (!(-2.0 * log((real_T)(int32_T)(icng + jsr) *
                              2.328306436538696E-10 + 0.5) > x * x));

        if (r < 0.0) {
          r = x - 2.776994;
        } else {
          r = 2.776994 - x;
        }
      }
    }
  }

  state[0] = icng;
  state[1] = jsr;
  return r;
}

/**
 * @name: 
 * @msg:  Function for MATLAB Function: ''真实状态' (':152')' 
 * @param {uint32_T} mt
 * @param {uint32_T} u
 * @return {*}
 */
static void Model_sim_genrand_uint32_vector(uint32_T mt[625], uint32_T u[2])
{
  int32_T j;
  int32_T kk;
  for (j = 0; j < 2; j++) {
    uint32_T mti;
    uint32_T y;
    mti = mt[624] + 1U;
    if (mt[624] + 1U >= 625U) {
      for (kk = 0; kk < 227; kk++) {
        mti = (mt[kk] & 2147483648U) | (mt[kk + 1] & 2147483647U);
        if ((mti & 1U) == 0U) {
          mti >>= 1U;
        } else {
          mti = mti >> 1U ^ 2567483615U;
        }

        mt[kk] = mt[kk + 397] ^ mti;
      }

      for (kk = 0; kk < 396; kk++) {
        mti = (mt[kk + 227] & 2147483648U) | (mt[kk + 228] & 2147483647U);
        if ((mti & 1U) == 0U) {
          mti >>= 1U;
        } else {
          mti = mti >> 1U ^ 2567483615U;
        }

        mt[kk + 227] = mt[kk] ^ mti;
      }

      mti = (mt[623] & 2147483648U) | (mt[0] & 2147483647U);
      if ((mti & 1U) == 0U) {
        mti >>= 1U;
      } else {
        mti = mti >> 1U ^ 2567483615U;
      }

      mt[623] = mt[396] ^ mti;
      mti = 1U;
    }

    y = mt[(int32_T)mti - 1];
    mt[624] = mti;
    y ^= y >> 11U;
    y ^= y << 7U & 2636928640U;
    y ^= y << 15U & 4022730752U;
    u[j] = y ^ y >> 18U;
  }
}

/**
 * @name: 
 * @msg:  Function for MATLAB Function: ''真实状态' (':152')' 
 * @param {uint32_T} mt
 * @return {*}
 */
static real_T Model_simulation_genrandu_f(uint32_T mt[625])
{
  real_T r;
  int32_T k;
  uint32_T u[2];

  /* ========================= COPYRIGHT NOTICE ============================ */
  /*  This is a uniform (0,1) pseudorandom number generator based on:        */
  /*                                                                         */
  /*  A C-program for MT19937, with initialization improved 2002/1/26.       */
  /*  Coded by Takuji Nishimura and Makoto Matsumoto.                        */
  /*                                                                         */
  /*  Copyright (C) 1997 - 2002, Makoto Matsumoto and Takuji Nishimura,      */
  /*  All rights reserved.                                                   */
  /*                                                                         */
  /*  Redistribution and use in source and binary forms, with or without     */
  /*  modification, are permitted provided that the following conditions     */
  /*  are met:                                                               */
  /*                                                                         */
  /*    1. Redistributions of source code must retain the above copyright    */
  /*       notice, this list of conditions and the following disclaimer.     */
  /*                                                                         */
  /*    2. Redistributions in binary form must reproduce the above copyright */
  /*       notice, this list of conditions and the following disclaimer      */
  /*       in the documentation and/or other materials provided with the     */
  /*       distribution.                                                     */
  /*                                                                         */
  /*    3. The names of its contributors may not be used to endorse or       */
  /*       promote products derived from this software without specific      */
  /*       prior written permission.                                         */
  /*                                                                         */
  /*  THIS SOFTWARE IS PROVIDED BY THE COPYRIGHT HOLDERS AND CONTRIBUTORS    */
  /*  "AS IS" AND ANY EXPRESS OR IMPLIED WARRANTIES, INCLUDING, BUT NOT      */
  /*  LIMITED TO, THE IMPLIED WARRANTIES OF MERCHANTABILITY AND FITNESS FOR  */
  /*  A PARTICULAR PURPOSE ARE DISCLAIMED.  IN NO EVENT SHALL THE COPYRIGHT  */
  /*  OWNER OR CONTRIBUTORS BE LIABLE FOR ANY DIRECT, INDIRECT, INCIDENTAL,  */
  /*  SPECIAL, EXEMPLARY, OR CONSEQUENTIAL DAMAGES (INCLUDING, BUT NOT       */
  /*  LIMITED TO, PROCUREMENT OF SUBSTITUTE GOODS OR SERVICES; LOSS OF USE,  */
  /*  DATA, OR PROFITS; OR BUSINESS INTERRUPTION) HOWEVER CAUSED AND ON ANY  */
  /*  THEORY OF LIABILITY, WHETHER IN CONTRACT, STRICT LIABILITY, OR TORT    */
  /*  (INCLUDING  NEGLIGENCE OR OTHERWISE) ARISING IN ANY WAY OUT OF THE USE */
  /*  OF THIS  SOFTWARE, EVEN IF ADVISED OF THE POSSIBILITY OF SUCH DAMAGE.  */
  /*                                                                         */
  /* =============================   END   ================================= */
  int32_T exitg1;
  do {
    exitg1 = 0;
    Model_sim_genrand_uint32_vector(mt, u);
    r = 1.1102230246251565E-16 * ((real_T)(u[0] >> 5U) * 6.7108864E+7 + (real_T)
      (u[1] >> 6U));
    if (r == 0.0) {
      boolean_T b_isvalid;
      b_isvalid = ((mt[624] >= 1U) && (mt[624] < 625U));
      if (b_isvalid) {
        boolean_T exitg2;
        b_isvalid = false;
        k = 1;
        exitg2 = false;
        while ((!exitg2) && (k < 625)) {
          if (mt[k - 1] == 0U) {
            k++;
          } else {
            b_isvalid = true;
            exitg2 = true;
          }
        }
      }

      if (!b_isvalid) {
        uint32_T b_r;
        b_r = 5489U;
        mt[0] = 5489U;
        for (k = 0; k < 623; k++) {
          b_r = ((b_r ^ b_r >> 30U) * 1812433253U + k) + 1U;
          mt[k + 1] = b_r;
        }

        mt[624] = 624U;
      }
    } else {
      exitg1 = 1;
    }
  } while (exitg1 == 0);

  return r;
}

/**
 * @name: 
 * @msg:  Function for MATLAB Function: ''真实状态' (':152')' 
 * @param {*}
 * @return {*}
 */
static real_T Model_simulation_randn(void)
{
  real_T c_u;
  real_T r;
  real_T x;
  uint32_T u32[2];
  uint32_T b_state;
  uint32_T d_state;
  static const real_T b[257] = { 0.0, 0.215241895984875, 0.286174591792068,
    0.335737519214422, 0.375121332878378, 0.408389134611989, 0.43751840220787,
    0.46363433679088, 0.487443966139235, 0.50942332960209, 0.529909720661557,
    0.549151702327164, 0.567338257053817, 0.584616766106378, 0.601104617755991,
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    3.65415288536101, 3.91075795952492 };

  static const real_T c[257] = { 1.0, 0.977101701267673, 0.959879091800108,
    0.9451989534423, 0.932060075959231, 0.919991505039348, 0.908726440052131,
    0.898095921898344, 0.887984660755834, 0.878309655808918, 0.869008688036857,
    0.860033621196332, 0.851346258458678, 0.842915653112205, 0.834716292986884,
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    0.00403797259336304, 0.00260907274610216, 0.0012602859304986,
    0.000477467764609386 };

  switch (Model_simulation_DW.method) {
   case 0U:
    {
      switch (Model_simulation_DW.method_n) {
       case 4U:
        do {
          Model_simulation_genrandu(Model_simulation_DW.state_c, &d_state, &c_u);
          Model_simulation_genrandu(d_state, &Model_simulation_DW.state_c, &x);
          c_u = 2.0 * c_u - 1.0;
          x = 2.0 * x - 1.0;
          x = x * x + c_u * c_u;
        } while (!(x <= 1.0));

        r = c_u * sqrt(-2.0 * log(x) / x);
        break;

       case 5U:
        r = Model_simulation_eml_rand_shr3cong(Model_simulation_DW.state_d);
        break;

       default:
        {
          int32_T exitg1;
          int32_T i;
          do {
            exitg1 = 0;
            Model_sim_genrand_uint32_vector(Model_simulation_DW.state_k, u32);
            i = (int32_T)((u32[1] >> 24U) + 1U);
            r = (((real_T)(u32[0] >> 3U) * 1.6777216E+7 + (real_T)((int32_T)u32
                   [1] & 16777215)) * 2.2204460492503131E-16 - 1.0) * b[i];
            if (fabs(r) <= b[i - 1]) {
              exitg1 = 1;
            } else if (i < 256) {
              x = Model_simulation_genrandu_f(Model_simulation_DW.state_k);
              if (c[i] + x * (c[i - 1] - c[i]) < exp(-0.5 * r * r)) {
                exitg1 = 1;
              }
            } else {
              do {
                x = Model_simulation_genrandu_f(Model_simulation_DW.state_k);
                x = log(x) * 0.273661237329758;
                c_u = Model_simulation_genrandu_f(Model_simulation_DW.state_k);
              } while (!(-2.0 * log(c_u) > x * x));

              if (r < 0.0) {
                r = x - 3.65415288536101;
              } else {
                r = 3.65415288536101 - x;
              }

              exitg1 = 1;
            }
          } while (exitg1 == 0);
        }
        break;
      }
    }
    break;

   case 4U:
    d_state = Model_simulation_DW.state[0];
    do {
      Model_simulation_genrandu(d_state, &b_state, &c_u);
      Model_simulation_genrandu(b_state, &d_state, &x);
      c_u = 2.0 * c_u - 1.0;
      x = 2.0 * x - 1.0;
      x = x * x + c_u * c_u;
    } while (!(x <= 1.0));

    r = c_u * sqrt(-2.0 * log(x) / x);
    Model_simulation_DW.state[0] = d_state;
    break;

   default:
    r = Model_simulation_eml_rand_shr3cong(Model_simulation_DW.state);
    break;
  }

  return r;
}

/**
 * @name: 
 * @msg:  Model initialize function 
 * @param {*}
 * @return {*}
 */
void Model_simulation_initialize(float init_soc,unsigned char _bat_pack_label)
{
  {
    uint32_T RandomSource_SEED_DWORK;
    static const uint32_T tmp[625] = { 5489U, 1301868182U, 2938499221U,
      2950281878U, 1875628136U, 751856242U, 944701696U, 2243192071U, 694061057U,
      219885934U, 2066767472U, 3182869408U, 485472502U, 2336857883U, 1071588843U,
      3418470598U, 951210697U, 3693558366U, 2923482051U, 1793174584U,
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      1367820199U, 2369854699U, 2844269403U, 79981964U, 624U };

    /* InitializeConditions for Memory: 'Memory1' (':172') */
    Model_simulation_DW.Memory1_PreviousInput[_bat_pack_label] = init_soc;

    /* InitializeConditions for Memory: 'Memory' (':153') */
    Model_simulation_DW.Memory_PreviousInput[0][_bat_pack_label] = init_soc;
    Model_simulation_DW.Memory_PreviousInput[1][_bat_pack_label] = 0.0;

    /* SystemInitialize for MATLAB Function: '真实状态' (':152') */
    memcpy(&Model_simulation_DW.state_k[0], &tmp[0], 625U * sizeof(uint32_T));
    Model_simulation_DW.method_n = 7U;
    Model_simulation_DW.state_c = 1144108930U;
    Model_simulation_DW.state[0] = 362436069U;
    Model_simulation_DW.state_d[0] = 362436069U;
    Model_simulation_DW.state[1] = 521288629U;
    Model_simulation_DW.state_d[1] = 521288629U;

    /* SystemInitialize for Atomic SubSystem: '等效模型' (':157') */
    /* InitializeConditions for S-Function (sdsprandsrc2): 'Random Source' (':259:3') */
    RandomSource_SEED_DWORK = 1U;
    RandSrcInitState_GZ(&RandomSource_SEED_DWORK,
                        &Model_simulation_DW.RandomSource_STATE_DWORK[0], 1);

    /* End of SystemInitialize for SubSystem: '等效模型' (':157') */
  }
}

/**
 * @name: 
 * @msg: 
 * @param {*}
 * @return {*}
 */
void RandSrc_GZ_D(real_T y[], const real_T mean[], int32_T meanLen, const real_T
                  xstd[], int32_T xstdLen, uint32_T state[], int32_T nChans,
                  int32_T nSamps)
{
  int32_T chan;
  int32_T samp;
  static const real_T vt[65] = { 0.340945, 0.4573146, 0.5397793, 0.6062427,
    0.6631691, 0.7136975, 0.7596125, 0.8020356, 0.8417227, 0.8792102, 0.9148948,
    0.9490791, 0.9820005, 1.0138492, 1.044781, 1.0749254, 1.1043917, 1.1332738,
    1.161653, 1.189601, 1.2171815, 1.2444516, 1.2714635, 1.298265, 1.3249008,
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    2.6713916, 2.7769942, 2.7769942, 2.7769942, 2.7769942 };

  /* S-Function (sdsprandsrc2): 'Random Source' (':259:3') */
  /* RandSrc_GZ_D */
  for (chan = 0; chan < nChans; chan++) {
    real_T std;
    int32_T icng_tmp;
    uint32_T icng;
    uint32_T jsr;
    std = xstd[xstdLen > 1 ? chan : 0];
    icng_tmp = chan << 1;
    icng = state[icng_tmp];
    jsr = state[icng_tmp + 1];
    for (samp = 0; samp < nSamps; samp++) {
      real_T r;
      real_T x;
      real_T y_0;
      int32_T i;
      int32_T j;
      icng = 69069U * icng + 1234567U;
      jsr ^= jsr << 13;
      jsr ^= jsr >> 17;
      jsr ^= jsr << 5;
      i = (int32_T)(icng + jsr);
      j = (i & 63) + 1;
      r = (real_T)i * 4.6566128730773926E-10 * vt[j];
      x = fabs(r);
      y_0 = vt[j - 1];
      if (x <= y_0) {
      } else {
        real_T s;
        x = (x - y_0) / (vt[j] - y_0);
        icng = 69069U * icng + 1234567U;
        jsr ^= jsr << 13;
        jsr ^= jsr >> 17;
        jsr ^= jsr << 5;
        y_0 = (real_T)(int32_T)(icng + jsr) * 2.328306436538696E-10 + 0.5;
        s = x + y_0;
        if (s > 1.301198) {
          r = r < 0.0 ? 0.4878992 * x - 0.4878992 : 0.4878992 - 0.4878992 * x;
        } else if (s <= 0.9689279) {
        } else {
          x = 0.4878992 - 0.4878992 * x;
          if (y_0 > 12.67706 - 12.37586 * exp(-0.5 * x * x)) {
            r = r < 0.0 ? -x : x;
          } else if (exp(-0.5 * vt[j] * vt[j]) + y_0 * 0.01958303 / vt[j] <= exp
                     (-0.5 * r * r)) {
          } else {
            do {
              icng = 69069U * icng + 1234567U;
              jsr ^= jsr << 13;
              jsr ^= jsr >> 17;
              jsr ^= jsr << 5;
              x = log((real_T)(int32_T)(icng + jsr) * 2.328306436538696E-10 +
                      0.5) / 2.776994;
              icng = 69069U * icng + 1234567U;
              jsr ^= jsr << 13;
              jsr ^= jsr >> 17;
              jsr ^= jsr << 5;
            } while (-2.0 * log((real_T)(int32_T)(icng + jsr) *
                                2.328306436538696E-10 + 0.5) <= x * x);

            r = r < 0.0 ? x - 2.776994 : 2.776994 - x;
          }
        }
      }

      y[chan * nSamps + samp] = mean[meanLen > 1 ? chan : 0] + std * r;
    }

    state[icng_tmp] = icng;
    state[icng_tmp + 1] = jsr;
  }

  /* End of S-Function (sdsprandsrc2): 'Random Source' (':259:3') */
}

/**
 * @name: 
 * @msg:  Model step function 
 * @param {*}
 * @return {*}
 */
void Model_simulation_step(double init_cap,unsigned char _bat_pack_label)
{
  real_T Gain1;
  real_T rtb_RandomSource;
  real_T tmp;
  real_T tmp_0;
  real_T y;
  real_T y_0;
  real_T y_tmp;

  /* Gain: 'Gain1' (':347') incorporates:
   *  Lookup_n-D: '1-D Lookup Table' (':341')
   *  Memory: 'Memory1' (':172')
   */
  Gain1 = rp_coef * look1_binlxpw(Model_simulation_DW.Memory1_PreviousInput[_bat_pack_label],
    Model_simulation_ConstP.pooled3, Model_simulation_ConstP.uDLookupTable_tableData, 6U);

  /* Lookup_n-D: '1-D Lookup Table1' (':342') incorporates:
   *  Memory: 'Memory1' (':172')
   */
  rtb_RandomSource = look1_binlxpw(Model_simulation_DW.Memory1_PreviousInput[_bat_pack_label],
    Model_simulation_ConstP.pooled3, Model_simulation_ConstP.uDLookupTable1_tableData, 6U);

  /* MATLAB Function: '真实状态' (':152') incorporates:
   *  Constant: 'Capacity' (':146')
   *  Constant: 'tr' (':143')
   *  Delay: 'Delay' (':184')
   *  Gain: 'Gain2' (':348')
   *  Memory: 'Memory' (':153')
   */
  /* MATLAB Function '模型仿真/真实状态': (':152:1') */
  /* (':152:1:2') tao = Rp * Cp; */
  /* (':152:1:3') Qs = ProNoise(1); */
  /* (':152:1:4') Qu = ProNoise(2); */
  /* (':152:1:6') A2=exp(-tr/tao); */
  /* (':152:1:7') A=[1 0;0 A2]; */
  /* (':152:1:8') B1 = -tr/(Capacity*3600); */
  /* (':152:1:9') B2=Rp*(1-exp(-tr/tao)); */
  /* (':152:1:10') B=[B1;B2]; */
  /* (':152:1:11') States_real = A*States_real + B*I_real + [sqrt(Qs)*randn;sqrt(Qu)*randn]; */
  y_tmp = exp(-SAMPLE_INTERVAL / (Gain1 * (1000.0 * rtb_RandomSource)));
  y = Model_simulation_DW.Memory_PreviousInput[0][_bat_pack_label] + 0.0 *
    Model_simulation_DW.Memory_PreviousInput[1][_bat_pack_label];
  y_0 = 0.0 * Model_simulation_DW.Memory_PreviousInput[0][_bat_pack_label] + y_tmp *
    Model_simulation_DW.Memory_PreviousInput[1][_bat_pack_label];
  tmp = Model_simulation_randn();
  tmp_0 = Model_simulation_randn();
  Model_simulation_DW.Memory_PreviousInput[0][_bat_pack_label] = (y + -2.7777777777777781E-4*SAMPLE_INTERVAL/init_cap *
    Model_simulation_DW.Delay_DSTATE[_bat_pack_label]) + 0.00014142135623730951 * tmp;
  Model_simulation_DW.Memory_PreviousInput[1][_bat_pack_label] = (y_0 + Gain1 * (1.0 - y_tmp) *
    Model_simulation_DW.Delay_DSTATE[_bat_pack_label]) + 0.0001 * tmp_0;

  /* Outport: 'SOC_real' (':370') */
  Model_simulation_Y[_bat_pack_label].SOC_real = Model_simulation_DW.Memory_PreviousInput[0][_bat_pack_label];

  /* Outputs for Atomic SubSystem: '等效模型' (':157') */
  /* S-Function (sdsprandsrc2): 'Random Source' (':259:3') */
  RandSrc_GZ_D(&rtb_RandomSource, &Model_simulation_ConstP.pooled1, 1,
               &Model_simulation_ConstP.pooled2, 1,
               Model_simulation_DW.RandomSource_STATE_DWORK, 1, 1);

  /* Outport: 'UL_obs' (':371') incorporates:
   *  Delay: 'Delay' (':184')
   *  Fcn: 'Fcn' (':161')
   *  Gain: 'Gain3' (':349')
   *  Lookup_n-D: '1-D Lookup Table2' (':343')
   *  Lookup_n-D: '1-D Lookup Table3' (':344')
   *  S-Function (scomawgnchan2): 'Dynamic AWGN' (':259:2')
   */
  Model_simulation_Y[_bat_pack_label].UL_obs = ((look1_binlxpw(Model_simulation_DW.Memory_PreviousInput[0][_bat_pack_label],
    Model_simulation_ConstP.uDLookupTable2_bp01Data,
    OCV_tableDate[_bat_pack_label], 9U) -
    Model_simulation_DW.Memory_PreviousInput[1][_bat_pack_label]) - Model_simulation_DW.Delay_DSTATE[_bat_pack_label] *
    (rint_coef[_bat_pack_label] * look1_binlxpw(Model_simulation_DW.Memory_PreviousInput[0][_bat_pack_label],
    Model_simulation_ConstP.pooled3, Model_simulation_ConstP.uDLookupTable3_tableData, 6U)))
    + 0.001 * rtb_RandomSource;

  /* End of Outputs for SubSystem: '等效模型' (':157') */

  /* Update for Delay: 'Delay' (':184') incorporates:
   *  Inport: 'I_real' (':369')
   */
  Model_simulation_DW.Delay_DSTATE[_bat_pack_label] = Model_simulation_U[_bat_pack_label].I_real;

  /* Update for Memory: 'Memory1' (':172') */
  Model_simulation_DW.Memory1_PreviousInput[_bat_pack_label] = Model_simulation_DW.Memory_PreviousInput[0][_bat_pack_label];
}
/******************************************模型仿真模块END******************************************/

/*******************************************EKF算法START*******************************************/
/*
 * Initialize rtInf needed by the generated code.
 * Inf is initialized as non-signaling. Assumes IEEE.
 */
static real_T rtGetInf(void)
{
  size_t bitsPerReal = sizeof(real_T) * (NumBitsPerChar);
  real_T inf = 0.0;
  if (bitsPerReal == 32U) {
    inf = rtGetInfF();
  } else {
    union {
      LittleEndianIEEEDouble bitVal;
      real_T fltVal;
    } tmpVal;

    tmpVal.bitVal.words.wordH = 0x7FF00000U;
    tmpVal.bitVal.words.wordL = 0x00000000U;
    inf = tmpVal.fltVal;
  }

  return inf;
}

/*
 * Initialize rtInfF needed by the generated code.
 * Inf is initialized as non-signaling. Assumes IEEE.
 */
static real32_T rtGetInfF(void)
{
  IEEESingle infF;
  infF.wordL.wordLuint = 0x7F800000U;
  return infF.wordL.wordLreal;
}

/*
 * Initialize rtMinusInf needed by the generated code.
 * Inf is initialized as non-signaling. Assumes IEEE.
 */
static real_T rtGetMinusInf(void)
{
  size_t bitsPerReal = sizeof(real_T) * (NumBitsPerChar);
  real_T minf = 0.0;
  if (bitsPerReal == 32U) {
    minf = rtGetMinusInfF();
  } else {
    union {
      LittleEndianIEEEDouble bitVal;
      real_T fltVal;
    } tmpVal;

    tmpVal.bitVal.words.wordH = 0xFFF00000U;
    tmpVal.bitVal.words.wordL = 0x00000000U;
    minf = tmpVal.fltVal;
  }

  return minf;
}

/*
 * Initialize rtMinusInfF needed by the generated code.
 * Inf is initialized as non-signaling. Assumes IEEE.
 */
static real32_T rtGetMinusInfF(void)
{
  IEEESingle minfF;
  minfF.wordL.wordLuint = 0xFF800000U;
  return minfF.wordL.wordLreal;
}

/*
 * Initialize rtNaN needed by the generated code.
 * NaN is initialized as non-signaling. Assumes IEEE.
 */
static real_T rtGetNaN(void)
{
  size_t bitsPerReal = sizeof(real_T) * (NumBitsPerChar);
  real_T nan = 0.0;
  if (bitsPerReal == 32U) {
    nan = rtGetNaNF();
  } else {
    union {
      LittleEndianIEEEDouble bitVal;
      real_T fltVal;
    } tmpVal;

    tmpVal.bitVal.words.wordH = 0xFFF80000U;
    tmpVal.bitVal.words.wordL = 0x00000000U;
    nan = tmpVal.fltVal;
  }

  return nan;
}

/*
 * Initialize rtNaNF needed by the generated code.
 * NaN is initialized as non-signaling. Assumes IEEE.
 */
static real32_T rtGetNaNF(void)
{
  IEEESingle nanF = { { 0.0F } };

  nanF.wordL.wordLuint = 0xFFC00000U;
  return nanF.wordL.wordLreal;
}

/*
 * Initialize the rtInf, rtMinusInf, and rtNaN needed by the
 * generated code. NaN is initialized as non-signaling. Assumes IEEE.
 */
static void rt_InitInfAndNaN(size_t realSize)
{
  (void) (realSize);
  rtNaN = rtGetNaN();
  rtNaNF = rtGetNaNF();
  rtInf = rtGetInf();
  rtInfF = rtGetInfF();
  rtMinusInf = rtGetMinusInf();
  rtMinusInfF = rtGetMinusInfF();
}

/* Test if value is infinite */
static boolean_T rtIsInf(real_T value)
{
  return (boolean_T)((value==rtInf || value==rtMinusInf) ? 1U : 0U);
}

/* Test if single-precision value is infinite */
static boolean_T rtIsInfF(real32_T value)
{
  return (boolean_T)(((value)==rtInfF || (value)==rtMinusInfF) ? 1U : 0U);
}

/* Test if value is not a number */
static boolean_T rtIsNaN(real_T value)
{
  boolean_T result = (boolean_T) 0;
  size_t bitsPerReal = sizeof(real_T) * (NumBitsPerChar);
  if (bitsPerReal == 32U) {
    result = rtIsNaNF((real32_T)value);
  } else {
    union {
      LittleEndianIEEEDouble bitVal;
      real_T fltVal;
    } tmpVal;

    tmpVal.fltVal = value;
    result = (boolean_T)((tmpVal.bitVal.words.wordH & 0x7FF00000) == 0x7FF00000 &&
                         ( (tmpVal.bitVal.words.wordH & 0x000FFFFF) != 0 ||
                          (tmpVal.bitVal.words.wordL != 0) ));
  }

  return result;
}

/* Test if single-precision value is not a number */
static boolean_T rtIsNaNF(real32_T value)
{
  IEEESingle tmp;
  tmp.wordL.wordLreal = value;
  return (boolean_T)( (tmp.wordL.wordLuint & 0x7F800000) == 0x7F800000 &&
                     (tmp.wordL.wordLuint & 0x007FFFFF) != 0 );
}

// static real_T look1_binlxpw(real_T u0, const real_T bp0[], const real_T table[],
//   uint32_T maxIndex)
// {
//   real_T frac;
//   real_T yL_0d0;
//   uint32_T iLeft;

//   /* Column-major Lookup 1-D
//      Search method: 'binary'
//      Use previous index: 'off'
//      Interpolation method: 'Linear point-slope'
//      Extrapolation method: 'Linear'
//      Use last breakpoint for index at or above upper limit: 'off'
//      Remove protection against out-of-range input in generated code: 'off'
//    */
//   /* Prelookup - Index and Fraction
//      Index Search method: 'binary'
//      Extrapolation method: 'Linear'
//      Use previous index: 'off'
//      Use last breakpoint for index at or above upper limit: 'off'
//      Remove protection against out-of-range input in generated code: 'off'
//    */
//   if (u0 <= bp0[0U]) {
//     iLeft = 0U;
//     frac = (u0 - bp0[0U]) / (bp0[1U] - bp0[0U]);
//   } else if (u0 < bp0[maxIndex]) {
//     uint32_T bpIdx;
//     uint32_T iRght;

//     /* Binary Search */
//     bpIdx = maxIndex >> 1U;
//     iLeft = 0U;
//     iRght = maxIndex;
//     while (iRght - iLeft > 1U) {
//       if (u0 < bp0[bpIdx]) {
//         iRght = bpIdx;
//       } else {
//         iLeft = bpIdx;
//       }

//       bpIdx = (iRght + iLeft) >> 1U;
//     }

//     frac = (u0 - bp0[iLeft]) / (bp0[iLeft + 1U] - bp0[iLeft]);
//   } else {
//     iLeft = maxIndex - 1U;
//     frac = (u0 - bp0[maxIndex - 1U]) / (bp0[maxIndex] - bp0[maxIndex - 1U]);
//   }

//   /* Column-major Interpolation 1-D
//      Interpolation method: 'Linear point-slope'
//      Use last breakpoint for index at or above upper limit: 'off'
//      Overflow mode: 'portable wrapping'
//    */
//   yL_0d0 = table[iLeft];
//   return (table[iLeft + 1U] - yL_0d0) * frac + yL_0d0;
// }

real_T rt_powd_snf(real_T u0, real_T u1)
{
  real_T y;
  if (rtIsNaN(u0) || rtIsNaN(u1)) {
    y = (rtNaN);
  } else {
    real_T tmp;
    real_T tmp_0;
    tmp = fabs(u0);
    tmp_0 = fabs(u1);
    if (rtIsInf(u1)) {
      if (tmp == 1.0) {
        y = 1.0;
      } else if (tmp > 1.0) {
        if (u1 > 0.0) {
          y = (rtInf);
        } else {
          y = 0.0;
        }
      } else if (u1 > 0.0) {
        y = 0.0;
      } else {
        y = (rtInf);
      }
    } else if (tmp_0 == 0.0) {
      y = 1.0;
    } else if (tmp_0 == 1.0) {
      if (u1 > 0.0) {
        y = u0;
      } else {
        y = 1.0 / u0;
      }
    } else if (u1 == 2.0) {
      y = u0 * u0;
    } else if ((u1 == 0.5) && (u0 >= 0.0)) {
      y = sqrt(u0);
    } else if ((u0 < 0.0) && (u1 > floor(u1))) {
      y = (rtNaN);
    } else {
      y = pow(u0, u1);
    }
  }

  return y;
}

/* Model step function */
void SOC_EKF_step(double init_cap,unsigned char _bat_pack_label)
{
  real_T A1[4];
  real_T A1_0[4];
  real_T P2[4];
  real_T rtb_C1;
  real_T rtb_Fcn_o_tmp;
  real_T rtb_Gain1;
  real_T rtb_K_idx_0;
  real_T rtb_K_idx_1;
  real_T tmp;
  real_T tmp_0;
  int32_T i;

  /* Gain: '<S1>/Gain1' incorporates:
   *  Lookup_n-D: '<S1>/1-D Lookup Table'
   *  UnitDelay: '<S1>/Unit Delay'
   */
  rtb_Gain1 = rp_coef * look1_binlxpw(SOC_EKF_DW[_bat_pack_label].UnitDelay_DSTATE,
    SOC_EKF_ConstP.pooled2, SOC_EKF_ConstP.uDLookupTable_tableData, 6U);

  /* Outputs for Atomic SubSystem: '<S1>/B矩阵' */
  /* Outputs for Atomic SubSystem: '<S1>/A矩阵' */
  /* Fcn: '<S2>/Fcn' incorporates:
   *  Constant: '<S1>/ts'
   *  Fcn: '<S3>/Fcn'
   *  Gain: '<S1>/Gain3'
   *  Lookup_n-D: '<S1>/1-D Lookup Table1'
   *  UnitDelay: '<S1>/Unit Delay'
   */
  rtb_Fcn_o_tmp = exp(-SAMPLE_INTERVAL / rtb_Gain1 / (1000.0 * look1_binlxpw
    (SOC_EKF_DW[_bat_pack_label].UnitDelay_DSTATE, SOC_EKF_ConstP.pooled2,
     SOC_EKF_ConstP.uDLookupTable1_tableData, 6U)));

  /* End of Outputs for SubSystem: '<S1>/A矩阵' */
  /* End of Outputs for SubSystem: '<S1>/B矩阵' */

  /* MATLAB Function: '<S1>/协方差矩阵预测' incorporates:
   *  Fcn: '<S2>/Fcn'
   *  UnitDelay: '<S1>/Unit Delay2'
   */
  /* MATLAB Function 'SOC_EKF/协方差矩阵预测': '<S6>:1' */
  /* '<S6>:1:2' A1 = [A(1) 0;0 A(2)]; */
  A1[0] = 1.0;
  A1[2] = 0.0;
  A1[1] = 0.0;

  /* Outputs for Atomic SubSystem: '<S1>/A矩阵' */
  A1[3] = rtb_Fcn_o_tmp;

  /* End of Outputs for SubSystem: '<S1>/A矩阵' */
  /* '<S6>:1:3' Qs = StaNoise(1); */
  /* '<S6>:1:4' Qu = StaNoise(2); */
  /* '<S6>:1:5' P1 = [P(1) P(2) ; P(3) P(4)]; */
  /* '<S6>:1:6' P2 = A1*P1*A1' + [Qs 0;0 Qu]; */
  rtb_K_idx_0 = SOC_EKF_DW[_bat_pack_label].UnitDelay2_DSTATE[0];
  rtb_K_idx_1 = SOC_EKF_DW[_bat_pack_label].UnitDelay2_DSTATE[1];
  tmp = SOC_EKF_DW[_bat_pack_label].UnitDelay2_DSTATE[2];
  tmp_0 = SOC_EKF_DW[_bat_pack_label].UnitDelay2_DSTATE[3];
  for (i = 0; i < 2; i++) {
    P2[i] = 0.0;
    P2[i] += A1[i] * rtb_K_idx_0;
    rtb_C1 = A1[i + 2];
    P2[i] += rtb_C1 * tmp;
    P2[i + 2] = 0.0;
    P2[i + 2] += A1[i] * rtb_K_idx_1;
    P2[i + 2] += rtb_C1 * tmp_0;
    A1_0[i] = 0.0;
    A1_0[i] += P2[i];
    A1_0[i] += P2[i + 2] * 0.0;
    A1_0[i + 2] = 0.0;
    A1_0[i + 2] += P2[i] * 0.0;

    /* Outputs for Atomic SubSystem: 'A矩阵' (':23') */
    A1_0[i + 2] += P2[i + 2] * rtb_Fcn_o_tmp;

    /* End of Outputs for SubSystem: 'A矩阵' (':23') */
  }

  /* Outputs for Atomic SubSystem: '<S1>/C矩阵' */
  /* Fcn: '<S4>/C1' incorporates:
   *  UnitDelay: '<S1>/Unit Delay'
   */
  /*  协方差矩阵预测 */
  /* '<S6>:1:7' P_Cov = [P2(1,1) P2(1,2) P2(2,1) P2(2,2)]; */
  rtb_C1 = (((1.71448 - 7.02494 * SOC_EKF_DW[_bat_pack_label].UnitDelay_DSTATE) + 17.12604 *
             rt_powd_snf(SOC_EKF_DW[_bat_pack_label].UnitDelay_DSTATE, 2.0)) - 20.27476 *
            rt_powd_snf(SOC_EKF_DW[_bat_pack_label].UnitDelay_DSTATE, 3.0)) + 9.33495 *
    rt_powd_snf(SOC_EKF_DW[_bat_pack_label].UnitDelay_DSTATE, 4.0);

  /* End of Outputs for SubSystem: '<S1>/C矩阵' */

  /* MATLAB Function: '<S1>/卡尔曼增益计算' incorporates:
   *  Constant: '<S1>/观测噪声'
   *  MATLAB Function: '<S1>/协方差矩阵更新'
   *  MATLAB Function: '<S1>/协方差矩阵预测'
   *  SignalConversion generated from: '<S7>/ SFunction '
   */
  /* MATLAB Function 'SOC_EKF/卡尔曼增益计算': '<S7>:1' */
  /* '<S7>:1:2' C1 = [C(1) C(2)]; */
  /* '<S7>:1:3' P = [P_Cov(1) P_Cov(2) ;  P_Cov(3) P_Cov(4)]; */
  P2[0] = A1_0[0] + 0.001;
  P2[2] = A1_0[2];
  P2[1] = A1_0[1];
  P2[3] = A1_0[3] + 0.001;

  /* '<S7>:1:4' K = P*C1'* (C1*P*C1'+R)^(-1); */
  rtb_K_idx_0 = rtb_C1 * (A1_0[0] + 0.001);
  rtb_K_idx_1 = 1.0 / (((rtb_K_idx_0 + -A1_0[1]) * rtb_C1 + -(rtb_C1 * A1_0[2] +
    -(A1_0[3] + 0.001))) + 0.001);
  rtb_K_idx_0 = (rtb_K_idx_0 + -A1_0[2]) * rtb_K_idx_1;
  rtb_K_idx_1 *= A1_0[1] * rtb_C1 + -(A1_0[3] + 0.001);

  /* MATLAB Function: '<S1>/协方差矩阵更新' incorporates:
   *  SignalConversion generated from: '<S5>/ SFunction '
   */
  /*  增益 */
  /* MATLAB Function 'SOC_EKF/协方差矩阵更新': '<S5>:1' */
  /* '<S5>:1:2' C = [C(1) C(2)]; */
  /* '<S5>:1:3' P = [P_Cov(1) P_Cov(2) ; P_Cov(3) P_Cov(4)]; */
  /* '<S5>:1:4' P1 = P - K * C * P; */
  A1_0[0] = rtb_K_idx_0 * rtb_C1;
  A1_0[1] = rtb_K_idx_1 * rtb_C1;
  A1_0[2] = -rtb_K_idx_0;
  A1_0[3] = -rtb_K_idx_1;
  for (i = 0; i < 2; i++) {
    rtb_C1 = A1_0[i + 2];
    A1[i] = P2[i] - (A1_0[i] * P2[0] + rtb_C1 * P2[1]);
    A1[i + 2] = P2[i + 2] - (A1_0[i] * P2[2] + rtb_C1 * P2[3]);
  }
  /* MATLAB Function: '<S1>/协方差矩阵更新' incorporates:
   *  UnitDelay: '<S1>/Unit Delay2'
   */
  /*  协方差矩阵更新 */
  /* '<S5>:1:5' P_upd = [P1(1,1) P1(1,2) P1(2,1) P1(2,2)]; */
  SOC_EKF_DW[_bat_pack_label].UnitDelay2_DSTATE[0] = A1[0];
  SOC_EKF_DW[_bat_pack_label].UnitDelay2_DSTATE[1] = A1[2];
  SOC_EKF_DW[_bat_pack_label].UnitDelay2_DSTATE[2] = A1[1];
  SOC_EKF_DW[_bat_pack_label].UnitDelay2_DSTATE[3] = A1[3];

  /* Sum: '<S9>/Sum' incorporates:
   *  Delay: '<S1>/Delay1'
   *  Fcn: '<S9>/Fcn'
   *  Product: '<S9>/Product'
   *  UnitDelay: '<S1>/Unit Delay'
   */
  rtb_C1 = SOC_EKF_ConstB.Fcn1*SAMPLE_INTERVAL/init_cap * SOC_EKF_DW[_bat_pack_label].Delay1_DSTATE +
    SOC_EKF_DW[_bat_pack_label].UnitDelay_DSTATE;

  /* Outputs for Atomic SubSystem: '<S1>/B矩阵' */
  /* Outputs for Atomic SubSystem: '<S1>/A矩阵' */
  /* Sum: '<S9>/Sum1' incorporates:
   *  Delay: '<S1>/Delay1'
   *  Fcn: '<S2>/Fcn'
   *  Fcn: '<S3>/Fcn'
   *  Fcn: '<S9>/Fcn1'
   *  Product: '<S9>/Product1'
   *  UnitDelay: '<S1>/Unit Delay1'
   */
  rtb_Gain1 = rtb_Gain1 * (1.0 - rtb_Fcn_o_tmp) * SOC_EKF_DW[_bat_pack_label].Delay1_DSTATE +
    rtb_Fcn_o_tmp * SOC_EKF_DW[_bat_pack_label].UnitDelay1_DSTATE;

  /* End of Outputs for SubSystem: '<S1>/A矩阵' */
  /* End of Outputs for SubSystem: '<S1>/B矩阵' */

  /* Outputs for Atomic SubSystem: '<S1>/端电压计算' */
  /* Fcn: '<S8>/Fcn3' incorporates:
   *  Delay: '<S1>/Delay'
   *  Delay: '<S1>/Delay1'
   *  Fcn: '<S10>/Fcn'
   *  Fcn: '<S8>/Fcn2'
   *  Gain: '<S1>/Gain2'
   *  Lookup_n-D: '<S1>/1-D Lookup Table3'
   *  Lookup_n-D: '<S1>/1-D Lookup Table4'
   *  Sum: '<S9>/Sum'
   *  UnitDelay: '<S1>/Unit Delay1'
   */
  rtb_Fcn_o_tmp = SOC_EKF_DW[_bat_pack_label].Delay_DSTATE - ((look1_binlxpw(rtb_C1,
    SOC_EKF_ConstP.uDLookupTable4_bp01Data,
    OCV_tableDate[_bat_pack_label], 9U) - rtb_Gain1) - rint_coef[_bat_pack_label]*
    look1_binlxpw(rtb_C1, SOC_EKF_ConstP.pooled2,
                  SOC_EKF_ConstP.uDLookupTable3_tableData, 6U) *
    SOC_EKF_DW[_bat_pack_label].Delay1_DSTATE);

  /* End of Outputs for SubSystem: '<S1>/端电压计算' */
  SOC_EKF_DW[_bat_pack_label].UnitDelay1_DSTATE = rtb_Gain1 + rtb_K_idx_1 * rtb_Fcn_o_tmp;

  /* Outport: '<Root>/SOC_upd' incorporates:
   *  UnitDelay: '<S1>/Unit Delay'
   */
  SOC_EKF_Y[_bat_pack_label].SOC_upd = SOC_EKF_DW[_bat_pack_label].UnitDelay_DSTATE;

  /* Update for UnitDelay: '<S1>/Unit Delay' incorporates:
   *  Fcn: '<S8>/Fcn2'
   */
  SOC_EKF_DW[_bat_pack_label].UnitDelay_DSTATE = rtb_C1 + rtb_K_idx_0 * rtb_Fcn_o_tmp;

  /* Update for Delay: '<S1>/Delay1' incorporates:
   *  Inport: '<Root>/I_obs'
   */
 SOC_EKF_DW[_bat_pack_label].Delay1_DSTATE = SOC_EKF_U.u_f;

  /* Update for Delay: '<S1>/Delay' incorporates:
   *  Inport: '<Root>/U_obs'
   */
  SOC_EKF_DW[_bat_pack_label].Delay_DSTATE = SOC_EKF_U.u;
}

/* Model initialize function */
void SOC_EKF_initialize(float init_soc,float max_volt,unsigned char _bat_pack_label)
{
  /* Registration code */

  /* initialize non-finites */
  rt_InitInfAndNaN(sizeof(real_T));

  /* InitializeConditions for UnitDelay: '<S1>/Unit Delay' */
  SOC_EKF_DW[_bat_pack_label].UnitDelay_DSTATE = init_soc;

  /* InitializeConditions for Delay: '<S1>/Delay' */
  SOC_EKF_DW[_bat_pack_label].Delay_DSTATE = max_volt;
}
/******************************************EKF算法END******************************************/

/******************************************信号添加噪声START****************************************/

void Noise_RandSrc_GZ_D(real_T y[], const real_T mean[], int32_T meanLen, const real_T
                  xstd[], int32_T xstdLen, uint32_T state[], int32_T nChans,
                  int32_T nSamps)
{
  int32_T chan;
  int32_T samp;
  static const real_T vt[65] = { 0.340945, 0.4573146, 0.5397793, 0.6062427,
    0.6631691, 0.7136975, 0.7596125, 0.8020356, 0.8417227, 0.8792102, 0.9148948,
    0.9490791, 0.9820005, 1.0138492, 1.044781, 1.0749254, 1.1043917, 1.1332738,
    1.161653, 1.189601, 1.2171815, 1.2444516, 1.2714635, 1.298265, 1.3249008,
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    2.6713916, 2.7769942, 2.7769942, 2.7769942, 2.7769942 };

  /* S-Function (sdsprandsrc2): '<S1>/Random Source' */
  /* RandSrc_GZ_D */
  for (chan = 0; chan < nChans; chan++) {
    real_T std;
    int32_T icng_tmp;
    uint32_T icng;
    uint32_T jsr;
    std = xstd[xstdLen > 1 ? chan : 0];
    icng_tmp = chan << 1;
    icng = state[icng_tmp];
    jsr = state[icng_tmp + 1];
    for (samp = 0; samp < nSamps; samp++) {
      real_T r;
      real_T x;
      real_T y_0;
      int32_T i;
      int32_T j;
      icng = 69069U * icng + 1234567U;
      jsr ^= jsr << 13;
      jsr ^= jsr >> 17;
      jsr ^= jsr << 5;
      i = (int32_T)(icng + jsr);
      j = (i & 63) + 1;
      r = (real_T)i * 4.6566128730773926E-10 * vt[j];
      x = fabs(r);
      y_0 = vt[j - 1];
      if (!(x <= y_0)) {
        real_T s;
        x = (x - y_0) / (vt[j] - y_0);
        icng = 69069U * icng + 1234567U;
        jsr ^= jsr << 13;
        jsr ^= jsr >> 17;
        jsr ^= jsr << 5;
        y_0 = (real_T)(int32_T)(icng + jsr) * 2.328306436538696E-10 + 0.5;
        s = x + y_0;
        if (s > 1.301198) {
          r = r < 0.0 ? 0.4878992 * x - 0.4878992 : 0.4878992 - 0.4878992 * x;
        } else if (!(s <= 0.9689279)) {
          x = 0.4878992 - 0.4878992 * x;
          if (y_0 > 12.67706 - exp(-0.5 * x * x) * 12.37586) {
            r = r < 0.0 ? -x : x;
          } else if (!(exp(-0.5 * vt[j] * vt[j]) + y_0 * 0.01958303 / vt[j] <=
                       exp(-0.5 * r * r))) {
            do {
              icng = 69069U * icng + 1234567U;
              jsr ^= jsr << 13;
              jsr ^= jsr >> 17;
              jsr ^= jsr << 5;
              x = log((real_T)(int32_T)(icng + jsr) * 2.328306436538696E-10 +
                      0.5) / 2.776994;
              icng = 69069U * icng + 1234567U;
              jsr ^= jsr << 13;
              jsr ^= jsr >> 17;
              jsr ^= jsr << 5;
            } while (log((real_T)(int32_T)(icng + jsr) * 2.328306436538696E-10 +
                         0.5) * -2.0 <= x * x);

            r = r < 0.0 ? x - 2.776994 : 2.776994 - x;
          }
        }
      }

      y[chan * nSamps + samp] = mean[meanLen > 1 ? chan : 0] + std * r;
    }

    state[icng_tmp] = icng;
    state[icng_tmp + 1] = jsr;
  }

  /* End of S-Function (sdsprandsrc2): '<S1>/Random Source' */
}
/* Model step function */
void Noise_step(void)
{
  real_T rtb_RandomSource;

  /* S-Function (sdsprandsrc2): '<S1>/Random Source' */
  Noise_RandSrc_GZ_D(&rtb_RandomSource, &Noise_ConstP.RandomSource_MeanRTP, 1,
               &Noise_ConstP.RandomSource_VarianceRTP, 1,
               Noise_DW.RandomSource_STATE_DWORK, 1, 1);

  /* Outport: '<Root>/Out1' incorporates:
   *  Inport: '<Root>/In1'
   *  Inport: '<Root>/Variance'
   *  S-Function (scomawgnchan2): '<S1>/Dynamic AWGN'
   */
  Noise_Y.Out1 = sqrt(Noise_U.Variance) * rtb_RandomSource + Noise_U.In1;
}

/* Model initialize function */
void Noise_initialize(void)
{
  {
    uint32_T RandomSource_SEED_DWORK;

    /* InitializeConditions for S-Function (sdsprandsrc2): '<S1>/Random Source' */
    RandomSource_SEED_DWORK = 1U;
    RandSrcInitState_GZ(&RandomSource_SEED_DWORK,
                        &Noise_DW.RandomSource_STATE_DWORK[0], 1);
  }
}
/******************************************信号添加噪声SEND******************************************/

/******************************************初始化容量START****************************************/
static real_T Cap_initial(real_T u0, real_T u1, const real_T bp0[], const
  real_T bp1[], const real_T table[], const uint32_T maxIndex[], uint32_T stride);
static real_T Cap_initial(real_T u0, real_T u1, const real_T bp0[], const
  real_T bp1[], const real_T table[], const uint32_T maxIndex[], uint32_T stride)
{
  real_T fractions[2];
  real_T frac;
  real_T yL_0d0;
  real_T yL_0d1;
  uint32_T bpIndices[2];
  uint32_T bpIdx;
  uint32_T iLeft;
  uint32_T iRght;

  /* Column-major Lookup 2-D
     Search method: 'binary'
     Use previous index: 'off'
     Interpolation method: 'Linear point-slope'
     Extrapolation method: 'Linear'
     Use last breakpoint for index at or above upper limit: 'off'
     Remove protection against out-of-range input in generated code: 'off'
   */
  /* Prelookup - Index and Fraction
     Index Search method: 'binary'
     Extrapolation method: 'Linear'
     Use previous index: 'off'
     Use last breakpoint for index at or above upper limit: 'off'
     Remove protection against out-of-range input in generated code: 'off'
   */
  if (u0 <= bp0[0U]) {
    iLeft = 0U;
    frac = (u0 - bp0[0U]) / (bp0[1U] - bp0[0U]);
  } else if (u0 < bp0[maxIndex[0U]]) {
    /* Binary Search */
    bpIdx = maxIndex[0U] >> 1U;
    iLeft = 0U;
    iRght = maxIndex[0U];
    while (iRght - iLeft > 1U) {
      if (u0 < bp0[bpIdx]) {
        iRght = bpIdx;
      } else {
        iLeft = bpIdx;
      }

      bpIdx = (iRght + iLeft) >> 1U;
    }

    frac = (u0 - bp0[iLeft]) / (bp0[iLeft + 1U] - bp0[iLeft]);
  } else {
    iLeft = maxIndex[0U] - 1U;
    frac = (u0 - bp0[maxIndex[0U] - 1U]) / (bp0[maxIndex[0U]] - bp0[maxIndex[0U]
      - 1U]);
  }

  fractions[0U] = frac;
  bpIndices[0U] = iLeft;

  /* Prelookup - Index and Fraction
     Index Search method: 'binary'
     Extrapolation method: 'Linear'
     Use previous index: 'off'
     Use last breakpoint for index at or above upper limit: 'off'
     Remove protection against out-of-range input in generated code: 'off'
   */
  if (u1 <= bp1[0U]) {
    iLeft = 0U;
    frac = (u1 - bp1[0U]) / (bp1[1U] - bp1[0U]);
  } else if (u1 < bp1[maxIndex[1U]]) {
    /* Binary Search */
    bpIdx = maxIndex[1U] >> 1U;
    iLeft = 0U;
    iRght = maxIndex[1U];
    while (iRght - iLeft > 1U) {
      if (u1 < bp1[bpIdx]) {
        iRght = bpIdx;
      } else {
        iLeft = bpIdx;
      }

      bpIdx = (iRght + iLeft) >> 1U;
    }

    frac = (u1 - bp1[iLeft]) / (bp1[iLeft + 1U] - bp1[iLeft]);
  } else {
    iLeft = maxIndex[1U] - 1U;
    frac = (u1 - bp1[maxIndex[1U] - 1U]) / (bp1[maxIndex[1U]] - bp1[maxIndex[1U]
      - 1U]);
  }

  /* Column-major Interpolation 2-D
     Interpolation method: 'Linear point-slope'
     Use last breakpoint for index at or above upper limit: 'off'
     Overflow mode: 'portable wrapping'
   */
  bpIdx = iLeft * stride + bpIndices[0U];
  yL_0d0 = table[bpIdx];
  yL_0d0 += (table[bpIdx + 1U] - yL_0d0) * fractions[0U];
  bpIdx += stride;
  yL_0d1 = table[bpIdx];
  return (((table[bpIdx + 1U] - yL_0d1) * fractions[0U] + yL_0d1) - yL_0d0) *
    frac + yL_0d0;
}
/******************************************初始化容量END****************************************/

/******************************************外部调用START****************************************/
float Cap_convert(int real_cur,int real_temp,unsigned char bat_state,unsigned char bat_pack_label)
{
  float cur_coeff = 0;
  float cap_coeff = 1;
  switch (bat_state)
  {
    case 2://放电
      cur_coeff =abs(real_cur)*0.1/_nominal_cap[bat_pack_label-1];
      cap_coeff = Cap_initial(real_temp*1.0/10, cur_coeff,  
        Cap_init_ConstP.temp_Data,
        Cap_init_ConstP.curcoeff_Data,
        Cap_init_ConstP.cap_tableData,
        Cap_init_ConstP.maxIndex, 8U);
     _initial_cap[bat_pack_label-1] = cap_coeff*_nominal_cap[bat_pack_label-1]; 
     break;

   default://充电,浮充，静置
     _initial_cap[bat_pack_label-1] = _nominal_cap[bat_pack_label-1];
     break;
  }
  return cap_coeff;
}

unsigned char App_deep_cycle_time(float *deep_cycle_time,int real_cur,int real_temp,unsigned char bat_state,unsigned char bat_pack_label)
{
  float deep_cycle =0,remain_deep_cycle;

  float temp_coeff =1,cur_coeff =1,cur_cap_coeff=1;
  cur_cap_coeff = abs(real_cur)*0.1/_nominal_cap[bat_pack_label-1];
  if(cur_cap_coeff>0.1f && cur_cap_coeff<=1)
    cur_coeff = -0.05f*cur_cap_coeff*10+1.05f;
  else
    cur_coeff =1;
  if(real_temp <0)
    temp_coeff =0.8;
  else if(real_temp>=0&&real_temp<100)
    temp_coeff =0.9;
  else if(real_temp >=400)
    temp_coeff = 1.1;
  else
    temp_coeff =1.0; 
  switch (bat_state)
  {
    case 1://充电
      _charge_add_cap[bat_pack_label-1] = _charge_add_cap[bat_pack_label-1]+real_cur*0.1/3600;
      break;
    
    case 2://放电
      _discharge_add_cap[bat_pack_label-1] = _discharge_add_cap[bat_pack_label-1]+abs(real_cur)*0.1/3600;
      break;
  }
  if(_charge_add_cap[bat_pack_label-1]!=0||_discharge_add_cap[bat_pack_label-1]!=0)
  {
    deep_cycle = (_charge_add_cap[bat_pack_label-1]+_discharge_add_cap[bat_pack_label-1])/(2*_nominal_cap[bat_pack_label-1]*temp_coeff*cur_coeff);
    if(deep_cycle>=0.001*_deep_cycle_time[bat_pack_label-1])
    {
       *deep_cycle_time = *deep_cycle_time-deep_cycle; 
      _charge_add_cap[bat_pack_label-1] =0;
      _discharge_add_cap[bat_pack_label-1] =0;
      if(*deep_cycle_time<=0)
      {
       *deep_cycle_time =0;
      }
      _diff_deep_cycle[bat_pack_label-1] = _diff_deep_cycle[bat_pack_label-1]+deep_cycle;
      #ifdef SOC_PRINTF 
       vs_printf("deep_cycle_time_%d=%.3f\r\n",bat_pack_label,*deep_cycle_time);  
      #endif 
       return 1;
    } 
  }
  return 0;
}
 /**
 * @name: 
 * @msg: 
 * @param {float} initial_cap:标称容量
 * @param {float} initial_soc：初始容量百分比
 * @param {float} float_charge_vol：浮充电压
 * @param {float} max_cycle_use_vol：均充压最大值
 * @param {float} mix_cycle_use_vol：放电截至电压
 * @return NULL
  */
void App_soc_intial(float initial_cap,unsigned int initial_soc,float real_vol, float float_charge_vol,float max_cycle_use_vol,float mix_cycle_use_vol,unsigned char bat_state,unsigned char bat_pack_label,unsigned char soc_retain_flag)
{
  float init_soc = 1;
  _max_vol[bat_pack_label-1] = max_cycle_use_vol;
  _min_vol[bat_pack_label-1] = mix_cycle_use_vol; 
  _float_vol[bat_pack_label-1] =  float_charge_vol; 
  _nominal_cap[bat_pack_label-1] = initial_cap;
  if (soc_retain_flag ==1)
  {
    init_soc = (float)initial_soc/1000.0f; 
  }
  else
  {
    switch (bat_state)
    {
    case 1://充电
      init_soc =(real_vol-mix_cycle_use_vol)/(max_cycle_use_vol-mix_cycle_use_vol);
      break;

    case 2://放电
      init_soc =(real_vol-mix_cycle_use_vol)/(max_cycle_use_vol*DISCHARG_COEF-mix_cycle_use_vol);
      break;

    case 0://静置
      init_soc =(real_vol-mix_cycle_use_vol)/(max_cycle_use_vol*DISCHARG_COEF-mix_cycle_use_vol);
      break;

    default://浮充
      init_soc = 1 ;
      break;
    }
  }
  if(init_soc >= 1)
    init_soc = 1;
  else if(init_soc <= 0)
    init_soc = 0;  
  SOC_EKF_Y[bat_pack_label-1].SOC_upd = init_soc;  
  return_soc[bat_pack_label-1] = (unsigned int)(init_soc*AMP_MUL);
  Model_simulation_Y[bat_pack_label-1].SOC_real = init_soc;
  Model_simulation_initialize(init_soc,bat_pack_label-1); 
  Noise_initialize();
  //SOC_EKF_initialize(init_soc,max_cycle_use_vol*DISCHARG_COEF,bat_pack_label-1);
  SOC_EKF_initialize(init_soc,real_vol,bat_pack_label-1);
  #ifdef SOC_PRINTF 
  vs_printf("init_soc_%d=%.3f\r\n",bat_pack_label-1,init_soc);  
  #endif  
}
/**
 * @name: 
 * @msg: Model_simulation_step：输入采集电流，输出预估电压和预估SOC；Noise_step：输入采集电流，输出噪声电流；SOC_EKF_step：输入噪声电流，输出EKF算法SOC
 * @msg: 初始上电1分钟自校准
 * @param {float} real_vol:实时电压
 * @param {float} real_cur:实时电流，放电时为-，充电时为+
 * @param {float} temp:实时温度
 * @param {float} clk_in_msec：计算时间
 * @param {unsigned char} bat_state：电池状态
 * @return {float}SOC,单位%
 */
unsigned int App_soc_process(float real_vol,float real_cur,float temp,float clk_in_sec,unsigned char bat_state,unsigned char bat_pack_label)
{
  unsigned int step_num =0;
  unsigned int step_time_num = clk_in_sec/SAMPLE_INTERVAL;
  // static float return_soc = 1;
  int  return_soc_buff =0;
  unsigned char i =0;
  unsigned char _bat_state =0;
  static unsigned char num[BAT_PACK_NUM] ={0};
  static unsigned char pre_bat_state[BAT_PACK_NUM] ={0};
  static unsigned char next_bat_state[BAT_PACK_NUM] ={0}; 
  _bat_state = bat_state;
  pre_bat_state[bat_pack_label-1] = bat_state; 

  if(_bat_state ==0||_bat_state==3)
  {
    if(real_vol >= (_float_vol[bat_pack_label-1]-FLOAT_VOLT_OFFSET))
      _bat_state = 3;
  }
  switch (_bat_state)
  {
  case 1://充电
    rint_coef[bat_pack_label-1]=1.0E-5;
    real_cur=fabs(real_cur);
    for(i=0;i<10;i++)
    {
      OCV_tableDate[bat_pack_label-1][i]=(_max_vol[bat_pack_label-1] - _min_vol[bat_pack_label-1])*0.1f*(i+1)+_min_vol[bat_pack_label-1];
    }    
    // return_soc[bat_pack_label-1] = (int)(SOC_EKF_Y[bat_pack_label-1].SOC_upd*AMP_MUL);
    // return_soc[bat_pack_label-1] = (int)(Model_simulation_Y[bat_pack_label-1].SOC_real*AMP_MUL ) ;
    if(return_soc[bat_pack_label-1] >= 1000)
    {
      Model_simulation_DW.Memory1_PreviousInput[bat_pack_label-1] = 1;
      Model_simulation_DW.Memory_PreviousInput[0][bat_pack_label-1] = 1;
      SOC_EKF_DW[bat_pack_label-1].UnitDelay_DSTATE = 1;
      SOC_EKF_Y[bat_pack_label-1].SOC_upd =1;
      return_soc[bat_pack_label-1] = 1000;
      return return_soc[bat_pack_label-1];
    }
    break;
  case 2://放电
    rint_coef[bat_pack_label-1]=1.0/6000;
    real_cur=-1*fabs(real_cur);
    for(i=0;i<10;i++)
    {
      OCV_tableDate[bat_pack_label-1][i]=(_max_vol[bat_pack_label-1]*DISCHARG_COEF - _min_vol[bat_pack_label-1])*0.1f*(i+1)+_min_vol[bat_pack_label-1];
    }  
    // return_soc[bat_pack_label-1] = (int)(SOC_EKF_Y[bat_pack_label-1].SOC_upd*AMP_MUL); 
    // return_soc[bat_pack_label-1] = (int)(Model_simulation_Y[bat_pack_label-1].SOC_real*AMP_MUL ) ;
    if(return_soc[bat_pack_label-1] <= 0)
    {
      Model_simulation_DW.Memory1_PreviousInput[bat_pack_label-1] = 0;
      Model_simulation_DW.Memory_PreviousInput[0][bat_pack_label-1] = 0;
      SOC_EKF_DW[bat_pack_label-1].UnitDelay_DSTATE = 0;
      SOC_EKF_Y[bat_pack_label-1].SOC_upd =0;
      return_soc[bat_pack_label-1] = 0;      
      return return_soc[bat_pack_label-1];
    }
    break; 
  case 0://静置
    {
      rint_coef[bat_pack_label-1]=1.0f/6000;
      for(i=0;i<10;i++)
      {   
        OCV_tableDate[bat_pack_label-1][i]=(_max_vol[bat_pack_label-1]*DISCHARG_COEF- _min_vol[bat_pack_label-1])*0.1f*(i+1)+_min_vol[bat_pack_label-1];
      } 
      if(return_soc[bat_pack_label-1] < 0)
      {
        Model_simulation_DW.Memory1_PreviousInput[bat_pack_label-1] = 0;
        Model_simulation_DW.Memory_PreviousInput[0][bat_pack_label-1] = 0;
        SOC_EKF_DW[bat_pack_label-1].UnitDelay_DSTATE = 0;
        SOC_EKF_Y[bat_pack_label-1].SOC_upd =0;
      }
      else if(return_soc[bat_pack_label-1] > 1000)
      {
        Model_simulation_DW.Memory1_PreviousInput[bat_pack_label-1] = 1;
        Model_simulation_DW.Memory_PreviousInput[0][bat_pack_label-1] = 1;
        SOC_EKF_DW[bat_pack_label-1].UnitDelay_DSTATE = 1;
        SOC_EKF_Y[bat_pack_label-1].SOC_upd =1;     
      }
      else
      {
        Model_simulation_DW.Memory1_PreviousInput[bat_pack_label-1] = SOC_EKF_Y[bat_pack_label-1].SOC_upd;
        Model_simulation_DW.Memory_PreviousInput[0][bat_pack_label-1] = SOC_EKF_Y[bat_pack_label-1].SOC_upd ;
        SOC_EKF_DW[bat_pack_label-1].UnitDelay_DSTATE = SOC_EKF_Y[bat_pack_label-1].SOC_upd ; 
        next_bat_state[bat_pack_label-1] = pre_bat_state[bat_pack_label-1];  
        return return_soc[bat_pack_label-1];
      }
    }
    break;      
  default://浮充
    {
      Model_simulation_DW.Memory1_PreviousInput[bat_pack_label-1] = 1;
      Model_simulation_DW.Memory_PreviousInput[0][bat_pack_label-1] = 1;
      SOC_EKF_DW[bat_pack_label-1].UnitDelay_DSTATE = 1;
      SOC_EKF_Y[bat_pack_label-1].SOC_upd =1;
      return_soc[bat_pack_label-1] =1000;
      next_bat_state[bat_pack_label-1] = pre_bat_state[bat_pack_label-1];  
      return return_soc[bat_pack_label-1];
    }
    break;
  } 
  if(next_bat_state[bat_pack_label-1] != pre_bat_state[bat_pack_label-1])
  {
    num[bat_pack_label-1]++;
    Model_simulation_DW.Memory1_PreviousInput[bat_pack_label-1] = SOC_EKF_Y[bat_pack_label-1].SOC_upd;
    Model_simulation_DW.Memory_PreviousInput[0][bat_pack_label-1] = SOC_EKF_Y[bat_pack_label-1].SOC_upd;  
    SOC_EKF_DW[bat_pack_label-1].UnitDelay_DSTATE = SOC_EKF_Y[bat_pack_label-1].SOC_upd; 
  }
   if(num[bat_pack_label-1]>=3)//电池状态不相等次数
  {
    num[bat_pack_label-1] = 0;
    next_bat_state[bat_pack_label-1] = pre_bat_state[bat_pack_label-1];
  }
  //算法
 for ( step_num = 0; step_num < step_time_num; step_num++)
 {
    Model_simulation_U[bat_pack_label-1].I_real=-1*real_cur;
    Model_simulation_step(_nominal_cap[bat_pack_label-1],bat_pack_label-1);
    Noise_U.Variance=NOISE_VARIANCE;
    Noise_U.In1=-1*real_cur;    
    Noise_step(); 
    SOC_EKF_U.u_f=Noise_Y.Out1;
    SOC_EKF_U.u=Model_simulation_Y[bat_pack_label-1].UL_obs;
    // SOC_EKF_U.u = real_vol;
    SOC_EKF_step(_nominal_cap[bat_pack_label-1],bat_pack_label-1);
  }
   return_soc_buff = (int)(SOC_EKF_Y[bat_pack_label-1].SOC_upd*AMP_MUL);
  // return_soc_buff = (int)(Model_simulation_Y[bat_pack_label-1].SOC_real*AMP_MUL ) ;

  if(bat_state == 1)
    {
      if(return_soc[bat_pack_label-1] <= return_soc_buff)
        return_soc[bat_pack_label-1] = return_soc_buff; 
    }
  else if(bat_state == 2)
    {
      if(return_soc[bat_pack_label-1] >= return_soc_buff)
        return_soc[bat_pack_label-1] = return_soc_buff; 
    }
  else
    return_soc[bat_pack_label-1] = return_soc_buff;  

  #ifdef SOC_PRINTF 
 
  vs_printf("Model_simulation.vol=%f,real_vol=%f,bat_pack=%d\r\n",Model_simulation_Y[bat_pack_label-1].UL_obs,real_vol,bat_pack_label);  
  vs_printf("Model_simulation.soc=%f,ekf_soc=%f,bat_pack=%d\r\n",Model_simulation_Y[bat_pack_label-1].SOC_real,SOC_EKF_Y[bat_pack_label-1].SOC_upd,bat_pack_label);
  vs_printf("return_soc_%d=%d\r\n",bat_pack_label,return_soc[bat_pack_label-1]);
  #endif
  if(return_soc[bat_pack_label-1]< 0)
  {
    Model_simulation_DW.Memory1_PreviousInput[bat_pack_label-1] = 0;
    Model_simulation_DW.Memory_PreviousInput[0][bat_pack_label-1] = 0;
    SOC_EKF_DW[bat_pack_label-1].UnitDelay_DSTATE = 0;
    return_soc[bat_pack_label-1] = 0;
  }
  else if(return_soc[bat_pack_label-1] > 1000)
  {
    Model_simulation_DW.Memory1_PreviousInput[bat_pack_label-1] = 1;
    Model_simulation_DW.Memory_PreviousInput[0][bat_pack_label-1] = 1;
    SOC_EKF_DW[bat_pack_label-1].UnitDelay_DSTATE = 1;
    return_soc[bat_pack_label-1] = 1000;
  }
  return return_soc[bat_pack_label-1];
} 
/**
 * @name: 
 * @msg: 在放电状态下备电时长
 * @param {unsigned char} bat_pack_label：电池组标签
 * @param {unsigned char} bat_state：电池状态
 * @return (float)电池备电时长
 */
unsigned int App_standby_time(unsigned char bat_pack_label,float real_cur,unsigned char bat_state)
{
  float standby_time =0;    
  if(bat_state==0 || bat_state==2 ||real_cur<=0)
  {
    if(real_cur ==0&&return_soc[bat_pack_label-1]>=1)
      return 65535;
    else if(real_cur ==0&&return_soc[bat_pack_label-1]==0)
      return 0;
    else
    {
      if(real_cur<0)
      {
        standby_time = _nominal_cap[bat_pack_label-1]*return_soc[bat_pack_label-1]/100/fabs(real_cur); 
        if(standby_time >=65535) 
          standby_time =65535; 
        return  (unsigned int)standby_time;
      }
      else
        return 65535;  
    }
  }
  else
    return 65535;
}
void App_soh_intial(unsigned int life,unsigned int intial_soh,float deep_cycle_time,unsigned char bat_pack_label)
{
   _bat_life[bat_pack_label-1]=life;
   _initial_soh[bat_pack_label-1]=intial_soh;
   _deep_cycle_time[bat_pack_label-1]=(unsigned int)deep_cycle_time;
}
/**
 * @name: 
 * @msg:  每月调用1次
 * @param {unsigned char} bat_pack_label：电池组标签
 * @param {float} pre_soh：计算前soh
 * @return (float)电池SOH衰减，计算后soh
 */
unsigned int App_soh_process(unsigned char bat_pack_label)
{
  unsigned int diff_soh =0,integ_time=0;
  float deci_time=0;
  if(_deep_cycle_time[bat_pack_label-1]!=0)
  {
    integ_time= _diff_deep_cycle[bat_pack_label-1] /(0.001*_deep_cycle_time[bat_pack_label-1]);
    if(integ_time>=1)
    {
      diff_soh= (unsigned int)(_diff_deep_cycle[bat_pack_label-1]*1000)/_deep_cycle_time[bat_pack_label-1];
      deci_time =_diff_deep_cycle[bat_pack_label-1] /(0.001*_deep_cycle_time[bat_pack_label-1])-integ_time;
      _diff_deep_cycle[bat_pack_label-1] = deci_time;
    }
  } 
  _initial_soh[bat_pack_label-1]=_initial_soh[bat_pack_label-1]-diff_soh;
  _initial_soh[bat_pack_label-1]=_initial_soh[bat_pack_label-1]-(unsigned int)((float)((100-BAT_BY_SOH)/(_bat_life[bat_pack_label-1]*12))*10);
  if(_initial_soh[bat_pack_label-1]<=0)
  {
    _initial_soh[bat_pack_label-1] = 0;
  }
  return _initial_soh[bat_pack_label-1];
}
/**
 * @name: 
 * @msg: 
 * @param {unsigned char} bat_pack_label
 * @return {*}
 */
void App_soc_terminate(unsigned char bat_pack_label)
{
  DW_SOC_EKF_T _SOC_EKF_DW={0};
  SOC_EKF_DW[bat_pack_label-1]=_SOC_EKF_DW;
}

/******************************************外部调用END****************************************/
